## meta-techleef-bsp/conf/machine/raspberrypi5-techleef.conf
```bitbake
#@TYPE: Machine
#@NAME: Raspberry Pi 5 Techleef Edition
#@DESCRIPTION: Machine configuration for Raspberry Pi 5 
require conf/machine/raspberrypi5.conf

MACHINEOVERRIDES .= ":raspberrypi5"

# Disable U-Boot and use the standard Raspberry Pi bootloader
RPI_USE_U_BOOT = "0"

# Extra packages
MACHINE_EXTRA_RRECOMMENDS += "kernel-modules"

# GPU / Graphics & Multimedia
# Enable VideoCore graphics (VC4) and Mesa for OpenGL/Vulkan
VC4GRAPHICS = "1"
PREFERRED_PROVIDER_virtual/libgles2 = "mesa"
PREFERRED_PROVIDER_virtual/egl = "mesa"
PREFERRED_PROVIDER_virtual/libgl = "mesa"
PACKAGECONFIG:append:pn-mesa = " vulkan-driver"
PACKAGECONFIG:append:pn-alsa-lib = " alsa-utils"

MACHINE_FEATURES += " \
    wifi \
    bluetooth \
    usbhost \
    usbgadget \
    vc4graphics \
    pci \
    alsa \
    camera \
    opengl \
    egl \
    vulkan \
"

# End of machine configuration
```

## meta-techleef-distro/conf/distro/techleef.conf
```bitbake
DISTRO = "techleef"
DISTRO_NAME = "TechLeef Reference Distribution for RASPBERRYPI5"
DISTRO_VERSION = "1.0"
DISTRO_CODENAME = "scarthgap"

MAINTAINER = "DISTRO CUSTUM FOR RASPBERRYPI5 by YOUSSEF MANTOURAN"

INIT_MANAGER = "systemd"

#use one tmp directory
TCLIBCAPPEND = ""

#Minimaze GPLv3 packages
require conf/distro/include/no-gplv3.inc

#Enhance security options for CFLAGS/LDFLAGS
require conf/distro/include/security_flags.inc

# DISTRO Features
DISTRO_FEATURES = "\
    bluetooth \
    bluez5 \
    ext2 ext4 \
    wifi \
    opengl \
    kms \
    vk \
    wayland \
    x11 \
    pam \
    systemd \
    alsa \
    pipewire \
    usrmerge \
    largefile \
    ipv4 ipv6 \
    nfs smbfs \
"
```
